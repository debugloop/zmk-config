## boards/shields/totem/Kconfig.defconfig
```kconfig
if SHIELD_TOTEM_DONGLE
config ZMK_KEYBOARD_NAME
    default "TOTEM"
config ZMK_SLEEP
    default n
config ZMK_SPLIT_ROLE_CENTRAL
    default y
config ZMK_USB
    default y
config ZMK_SPLIT_BLE_CENTRAL_PERIPHERALS
    default 2
config ZMK_SPLIT_BLE_CENTRAL_BATTERY_LEVEL_FETCHING
    default y
endif

if SHIELD_TOTEM_LEFT || SHIELD_TOTEM_RIGHT
config ZMK_SLEEP
    default y
config ZMK_IDLE_SLEEP_TIMEOUT
    default 1800000
endif

if SHIELD_TOTEM_LEFT || SHIELD_TOTEM_RIGHT || SHIELD_TOTEM_DONGLE
config ZMK_SPLIT
    default y
config ZMK_BLE_EXPERIMENTAL_CONN
    default y
config ZMK_POINTING
    default y
endif
```

## config/west.yml
```yaml
manifest:
  remotes:
    - name: zmkfirmware
      url-base: https://github.com/zmkfirmware
    - name: urob
      url-base: https://github.com/urob
    - name: badjeff
      url-base: https://github.com/badjeff
  projects:
    - name: zmk
      remote: zmkfirmware
      revision: edf5c0814fd3ea202e43aad2d68fd32e882a518c # v0.3.0
      import: app/west.yml
    - name: zmk-adaptive-key
      remote: urob
      revision: e987227d625e8863343baf16bd11ff90310482a5 # main
    - name: zmk-leader-key
      remote: urob
      revision: 4745294d5f2bc12bbdf91471dd85bfbdbb35c47d # main
    - name: zmk-auto-layer
      remote: urob
      revision: b50d514219c5ad61198f9a8be137c59d0674b11c # main
    - name: zmk-behavior-battery-percentage-printer
      remote: badjeff
      revision: e111cbc6ac66caaa157daeb58eda3c8e2b43153a # main
  self:
    path: config
```
